#include "bsp.h"

/**
 * @file bsp_temperature.c
 * @brief PT100 温度换算与平均滤波。
 *
 * ADC 采样得到 PT100 分压点电压后，本模块先根据分压公式反推出 PT100
 * 电阻值，再通过 RTD_TAB_PT100 查表和线性插值计算温度。为了避免单次
 * ADC 噪声误触发过温保护，温度会先累加，之后每 10000 个控制周期更新
 * 一次 SafeTemp。
 */

/* 温度累计值，仅本模块内部使用。 */
static float MotoTempAdd;
/* 过滤后的安全温度值，保护模块通过 bsp.h 中的 extern 读取。 */
float SafeTemp;

/*
 * PT100 标准电阻表，步长 5 摄氏度，范围 -200~850 摄氏度。
 * 下标和温度关系：
 *   index = 0   -> -200℃
 *   index = 40  -> 0℃
 *   index = 210 -> 850℃
 * 换算公式为 temperature = index * 5 - 200。
 */
static const float RTD_TAB_PT100[211] =
{
    18.52, 20.68, 22.83, 24.97, 27.10, 29.22, 31.34, 33.44, 35.54, 37.64,
    39.72, 41.80, 43.88, 45.94, 48.00, 50.06, 52.11, 54.15, 56.19, 58.23,
    60.26, 62.28, 64.30, 66.31, 68.33, 70.33, 72.33, 74.33, 76.33, 78.32,
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    375.70, 377.19, 378.68, 380.17, 381.65, 383.13, 384.60, 386.08, 387.55, 389.02,
    390.48
};

/**
 * @brief 根据 PT100 电阻值计算温度。
 * @param fR PT100 电阻值，单位欧姆。
 * @return 温度值，单位摄氏度；-1 表示低于表格范围，-2 表示高于表格范围。
 *
 * 查找流程：
 *   1. 先判断是否超出 RTD_TAB_PT100 覆盖范围；
 *   2. 使用二分法找到 fR 所在的两个表格点；
 *   3. 在两个表格点之间做线性插值，得到更平滑的温度值。
 */
float CalculateTemperature(float fR)
{
    float fTem;
    float fLowRValue;
    float fHighRValue;
    int iTem;
    unsigned char i;
    unsigned char cBottom, cTop;

    /* 低于 -200℃ 对应电阻值，认为超下限。 */
    if (fR < RTD_TAB_PT100[0])
    {
        return -1;
    }

    /* 高于 850℃ 对应电阻值，认为超上限。 */
    if (fR > RTD_TAB_PT100[210])
    {
        return -2;
    }

    /* 二分查找的上下边界。 */
    cBottom = 0;
    cTop = 210;

    /*
     * 通过二分法寻找相邻两个表格点：
     *   cBottom 对应低端电阻；
     *   cTop    对应高端电阻。
     * 当二者只相差 1 时，fR 就落在这个 5℃ 区间内。
     */
    for (i = 105; (cTop - cBottom) != 1;)
    {
        if (fR < RTD_TAB_PT100[i])
        {
            cTop = i;
            i = (cTop + cBottom) / 2;
        }
        else if (fR > RTD_TAB_PT100[i])
        {
            cBottom = i;
            i = (cTop + cBottom) / 2;
        }
        else
        {
            /* 恰好命中表格点时，不需要插值，直接返回对应温度。 */
            iTem = (unsigned int)i * 5 - 200;
            fTem = (float)iTem;
            return fTem;
        }
    }

    iTem = (unsigned int)i * 5 - 200;
    fLowRValue = RTD_TAB_PT100[cBottom];
    fHighRValue = RTD_TAB_PT100[cTop];
    /* 在相邻两个 5℃ 表格点之间做线性插值。 */
    fTem = (((fR - fLowRValue) * 5) / (fHighRValue - fLowRValue)) + iTem;

    return fTem;
}

/**
 * @brief 将一次温度 ADC 原始值转换为温度并加入累计值。
 * @param raw_adc PT100 分压点 ADC 原始码值。
 *
 * 分压电路按原工程公式计算：
 *   tempV = raw_adc / 4096 * 3300mV
 *   Rpt   = 150 * tempV / (3300 - tempV)
 * 这里的 150 是分压电阻阻值，单位欧姆。
 */
void BspTemperature_Accumulate(uint16_t raw_adc)
{
    /* 使用原工程整数形式保留行为一致性，结果单位 mV。 */
    float tempV = (float)(raw_adc * 3300 / 4096);
    float Rpt = 150 * tempV / (3300 - tempV);

    MotoTempAdd = MotoTempAdd + CalculateTemperature(Rpt);
}

/**
 * @brief 温度平均滤波计时。
 *
 * 每调用 10000 次，把 MotoTempAdd 的平均值写入 SafeTemp，然后清零累计值。
 * 该函数在 ADC 控制周期末尾调用，因此平均窗口长度等于 10000 个控制周期。
 */
void BspTemperature_FilterTick(void)
{
    static uint16_t Temp_time_count;

    /* 在第 10000 次样本到达时更新平均温度。 */
    if (Temp_time_count == 9999)
    {
        SafeTemp = MotoTempAdd / 10000;
        MotoTempAdd = 0;
    }

    /* 计数器循环到 10000 后归零，开始下一轮平均窗口。 */
    Temp_time_count++;
    if (Temp_time_count == 10000)
    {
        Temp_time_count = 0;
    }
}
